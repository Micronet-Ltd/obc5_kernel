/* Copyright (c) 2013, The Linux Foundation. All rights reserved.
 *
 * This program is free software; you can redistribute it and/or modify
 * it under the terms of the GNU General Public License version 2 and
 * only version 2 as published by the Free Software Foundation.
 *
 * This program is distributed in the hope that it will be useful,
 * but WITHOUT ANY WARRANTY; without even the implied warranty of
 * MERCHANTABILITY or FITNESS FOR A PARTICULAR PURPOSE.  See the
 * GNU General Public License for more details.
 */

/*---------------------------------------------------------------------------
 * This file is autogenerated file using gcdb parser. Please do not edit it.
 * Update input XML file to add a new entry or update variable in this file
 * VERSION = "1.0"
 *creat by jiao.shp
 *---------------------------------------------------------------------------*/
&mdss_mdp {
	dsi_samsung_s6d7aa0x01_1280_800_video: qcom,mdss_dsi_samsung_s6d7aa0x01_1280_800_video {
		qcom,mdss-dsi-panel-name = "s6d7aa0x01 1280 800 video mode dsi panel";
		qcom,mdss-dsi-panel-controller = <&mdss_dsi0>;
		qcom,mdss-dsi-panel-type = "dsi_video_mode";
		qcom,mdss-dsi-panel-destination = "display_1";
		qcom,mdss-dsi-panel-framerate = <60>;
		qcom,mdss-dsi-virtual-channel-id = <0>;
		qcom,mdss-dsi-stream = <0>;
		qcom,mdss-dsi-panel-width = <800>;
		qcom,mdss-dsi-panel-height = <1280>;
		qcom,mdss-dsi-h-front-porch = <16>;
		qcom,mdss-dsi-h-back-porch = <48>;
		qcom,mdss-dsi-h-pulse-width = <16>;
		qcom,mdss-dsi-h-sync-skew = <0>;
		qcom,mdss-dsi-v-back-porch = <4>;
		qcom,mdss-dsi-v-front-porch = <8>;
		qcom,mdss-dsi-v-pulse-width = <4>;
		qcom,mdss-dsi-h-left-border = <0>;
		qcom,mdss-dsi-h-right-border = <0>;
		qcom,mdss-dsi-v-top-border = <0>;
		qcom,mdss-dsi-v-bottom-border = <0>;
		qcom,mdss-dsi-bpp = <24>;
		qcom,mdss-dsi-color-order = "0";//"rgb_swap_rgb";
		qcom,mdss-dsi-underflow-color = <0xff>;
		qcom,mdss-dsi-border-color = <0>;
        qcom,mdss-dsi-pixel-packing = <0>;
		qcom,mdss-dsi-on-command = [			
            39 01 00 00 00 00 03 F0 5A 5A                                             
            39 01 00 00 00 00 03 F1 5A 5A                                             
            39 01 00 00 00 00 03 FC A5 A5                                             
            39 01 00 00 00 00 02 B1 10                                                
            39 01 00 00 00 00 05 B2 14 22 2F 04  
            39 01 00 00 00 00 06 F2 02 04 08 30 10  
            //39 01 00 00 00 00 06 F2 02 08 08 40 10                                    
            39 01 00 00 00 00 02 B0 03                                                
            39 01 00 00 00 00 03 FD 23 09                                             
            39 01 00 00 00 00 0B F3 01 D7 E2 62 F4 F7 77 3C 26 00                     
            39 01 00 00 00 00 12 F4 00 02 03 26 03 02 09 00 07 16 16 03 00 08 08 03 0E
            39 01 00 00 00 00 12 F5 84 2F 2F 5F AB 98 52 0F 33 43 04 59 54 52 05 40 60
            39 01 00 00 00 00 09 EE 25 00 25 00 25 00 25 00                           
            39 01 00 00 00 00 09 EF 34 12 98 BA 20 00 24 80                           
            39 01 00 00 00 00 12 F7 0E 0E 0A 0A 0F 0F 0B 0B 05 07 01 01 01 01 01 01 0C
            39 01 00 00 00 00 04 BC 01 4E 0A                                          
            39 01 00 00 00 00 06 E1 03 10 1C A0 10                                    
            39 01 00 00 00 00 07 F6 60 21 A6 00 00 00                                 
            39 01 00 00 00 00 07 FE 00 0D 03 21 00 48                                 
            39 01 00 00 00 00 02 B0 22                                                
            39 01 00 00 00 00 12 FA 02 34 09 13 0B 0F 16 16 17 1E 1D 1C 1E 1D 1D 1F 24
            39 01 00 00 00 00 02 B0 22                                                
            39 01 00 00 00 00 12 FB 00 34 07 11 09 0D 14 14 15 1C 1F 1C 1D 1D 1D 20 26
            39 01 00 00 00 00 02 B0 11                                                
            39 01 00 00 00 00 12 FA 20 34 24 27 19 1B 1F 1E 1B 1F 21 1F 1E 20 1E 1E 21
            39 01 00 00 00 00 02 B0 11             
            39 01 00 00 00 00 12 FB 1E 34 22 25 17 19 1D 1A 19 20 1F 1E 20 1E 1E 1F 22
            39 01 00 00 00 00 12 FA 1C 34 1C 1F 13 17 1A 18 18 1E 20 21 21 21 23 22 2A
            39 01 00 00 00 00 12 FB 1A 34 1A 1D 11 15 18 16 16 1C 20 20 20 1F 23 23 2B	
            //15 01 00 00 00 00 02 36 10//rotate 14
             39 01 00 00 00 00 02 00 00
             39 01 00 00 00 00 02 51 ff
             39 01 00 00 00 00 02 00 00
             39 01 00 00 00 00 02 53 2c
             39 01 00 00 00 00 02 00 00
             39 01 00 00 00 00 02 55 01  
			05 01 00 00 78 00 02 11 00
			39 01 00 00 00 00 04 C3 40 00 28
			39 01 00 00 00 00 02 35 00
			05 01 00 00 28 00 02 29 00
		];
		qcom,mdss-dsi-off-command = [
			05 01 00 00 28 00 02 28 00
			05 01 00 00 78 00 02 10 00
		];
		qcom,mdss-dsi-on-command-state = "dsi_lp_mode";
		qcom,mdss-dsi-off-command-state = "dsi_lp_mode";
		qcom,mdss-dsi-h-sync-pulse = <1>;
		qcom,mdss-dsi-traffic-mode = "2";//"non_burst_sync_pulse";
		qcom,mdss-dsi-lane-map = "0";//"lane_map_0123";
		qcom,mdss-dsi-bllp-eof-power-mode;
		qcom,mdss-dsi-bllp-power-mode;
		qcom,mdss-dsi-lane-0-state;
		qcom,mdss-dsi-lane-1-state;
		qcom,mdss-dsi-lane-2-state;
		qcom,mdss-dsi-lane-3-state;
        qcom,mdss-dsi-panel-timings = [ 7B 1A 10 00 3C 42 14 1C 15 03 04 00 ];
		qcom,mdss-dsi-panel-orientation = "180";//for lcd rotate
		qcom,mdss-dsi-t-clk-post = <0x20>;
		qcom,mdss-dsi-t-clk-pre = <0x3e>;
		qcom,mdss-dsi-bl-min-level = <1>;
		qcom,mdss-dsi-bl-max-level = <255>;
		qcom,mdss-dsi-dma-trigger = "4";//"trigger_sw";
		qcom,mdss-dsi-mdp-trigger = "0";//"none";
		qcom,mdss-pan-bl-levels = <1 255>;
		qcom,mdss-dsi-bl-pmic-control-type = "bl_ctrl_i2c";
		qcom,mdss-dsi-reset-sequence = <1 20>, <0 20>, <1 120>;     
	};
};

