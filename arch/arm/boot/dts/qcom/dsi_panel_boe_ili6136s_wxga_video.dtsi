/* Copyright (c) 2013, The Linux Foundation. All rights reserved.
 *
 * This program is free software; you can redistribute it and/or modify
 * it under the terms of the GNU General Public License version 2 and
 * only version 2 as published by the Free Software Foundation.
 *
 * This program is distributed in the hope that it will be useful,
 * but WITHOUT ANY WARRANTY; without even the implied warranty of
 * MERCHANTABILITY or FITNESS FOR A PARTICULAR PURPOSE.  See the
 * GNU General Public License for more details.
 */

/*---------------------------------------------------------------------------
 * This file is autogenerated file using gcdb parser. Please do not edit it.
 * Update input XML file to add a new entry or update variable in this file
 * VERSION = "1.0"
 *creat by jiao.shp
 *---------------------------------------------------------------------------*/
&mdss_mdp {
	dsi_boe_ili6136s_wxga_video: qcom,mdss_dsi_boe_ili6336_wxga_video {
		qcom,mdss-dsi-panel-name = "boe wxga video mode dsi panel";
		qcom,mdss-dsi-panel-controller = <&mdss_dsi0>;
		qcom,mdss-dsi-panel-type = "dsi_video_mode";
		qcom,mdss-dsi-panel-destination = "display_1";
		qcom,mdss-dsi-panel-framerate = <60>;
		qcom,mdss-dsi-virtual-channel-id = <0>;
		qcom,mdss-dsi-stream = <0>;
		qcom,mdss-dsi-panel-width = <800>;
		qcom,mdss-dsi-panel-height = <1280>;
		qcom,mdss-dsi-h-front-porch = <16>;
		qcom,mdss-dsi-h-back-porch = <48>;
		qcom,mdss-dsi-h-pulse-width = <16>;
		qcom,mdss-dsi-h-sync-skew = <0>;
		qcom,mdss-dsi-v-back-porch = <4>;
		qcom,mdss-dsi-v-front-porch = <8>;
		qcom,mdss-dsi-v-pulse-width = <4>;
		qcom,mdss-dsi-h-left-border = <0>;
		qcom,mdss-dsi-h-right-border = <0>;
		qcom,mdss-dsi-v-top-border = <0>;
		qcom,mdss-dsi-v-bottom-border = <0>;
		qcom,mdss-dsi-bpp = <24>;
		qcom,mdss-dsi-color-order = "0";
		qcom,mdss-dsi-underflow-color = <0xff>;
		qcom,mdss-dsi-border-color = <0>;
        qcom,mdss-dsi-pixel-packing = <0>;
		qcom,mdss-dsi-on-command = [			
39 01 00 00 00 00 04  FF 61 36 08
39 01 00 00 00 00 02  1C A0
39 01 00 00 00 00 04  FF 61 36 01
39 01 00 00 00 00 02  31 19
39 01 00 00 00 00 04  FF 61 36 01
39 01 00 00 00 00 02  50 A9
39 01 00 00 00 00 04  FF 61 36 01
39 01 00 00 00 00 02  51 A4
39 01 00 00 00 00 04  FF 61 36 01
39 01 00 00 00 00 02  53 8C
39 01 00 00 00 00 04  FF 61 36 08
39 01 00 00 00 00 02  4C 00
39 01 00 00 00 00 02  78 04
39 01 00 00 00 00 02  8E 0F
39 01 00 00 00 00 02  93 03	    	    	    
39 01 00 00 00 00 04  FF 61 36 07
39 01 00 00 00 00 02  03 20
39 01 00 00 00 00 02  04 04
39 01 00 00 00 00 02  05 00
39 01 00 00 00 00 02  06 00
39 01 00 00 00 00 02  07 00
39 01 00 00 00 00 02  08 00
39 01 00 00 00 00 02  09 00
39 01 00 00 00 00 02  0A 01
39 01 00 00 00 00 02  0B 01
39 01 00 00 00 00 02  0C 01
39 01 00 00 00 00 02  0D 1E
39 01 00 00 00 00 02  0E 01
39 01 00 00 00 00 02  0F 01 		
39 01 00 00 00 00 02  10 40
39 01 00 00 00 00 02  11 02
39 01 00 00 00 00 02  12 05
39 01 00 00 00 00 02  13 00
39 01 00 00 00 00 02  14 00
39 01 00 00 00 00 02  15 00
39 01 00 00 00 00 02  16 01
39 01 00 00 00 00 02  17 01
39 01 00 00 00 00 02  18 00
39 01 00 00 00 00 02  19 00
39 01 00 00 00 00 02  1A 00
39 01 00 00 00 00 02  1B C0
39 01 00 00 00 00 02  1C BB
39 01 00 00 00 00 02  1D 0B
39 01 00 00 00 00 02  1E 00
39 01 00 00 00 00 02  1F 00		
39 01 00 00 00 00 02  20 00
39 01 00 00 00 00 02  21 00
39 01 00 00 00 00 02  22 00
39 01 00 00 00 00 02  23 C0
39 01 00 00 00 00 02  24 30
39 01 00 00 00 00 02  25 00
39 01 00 00 00 00 02  26 00
39 01 00 00 00 00 02  27 03
39 01 00 00 00 00 02  30 01
39 01 00 00 00 00 02  31 23
39 01 00 00 00 00 02  32 55
39 01 00 00 00 00 02  33 67
39 01 00 00 00 00 02  34 89
39 01 00 00 00 00 02  35 AB
39 01 00 00 00 00 02  36 01
39 01 00 00 00 00 02  37 23
39 01 00 00 00 00 02  38 45
39 01 00 00 00 00 02  39 67
39 01 00 00 00 00 02  3A 44
39 01 00 00 00 00 02  3B 55
39 01 00 00 00 00 02  3C 66
39 01 00 00 00 00 02  3D 77
39 01 00 00 00 00 02  50 00
39 01 00 00 00 00 02  51 0D
39 01 00 00 00 00 02  52 0D
39 01 00 00 00 00 02  53 0C
39 01 00 00 00 00 02  54 0C
39 01 00 00 00 00 02  55 0F
39 01 00 00 00 00 02  56 0F
39 01 00 00 00 00 02  57 0E
39 01 00 00 00 00 02  58 0E
39 01 00 00 00 00 02  59 06
39 01 00 00 00 00 02  5A 07
39 01 00 00 00 00 02  5B 1F
39 01 00 00 00 00 02  5C 1F
39 01 00 00 00 00 02  5D 1F
39 01 00 00 00 00 02  5E 1F
39 01 00 00 00 00 02  5F 1F 		
39 01 00 00 00 00 02  60 1F
39 01 00 00 00 00 02  67 06
39 01 00 00 00 00 02  68 13
39 01 00 00 00 00 02  69 0F
39 01 00 00 00 00 02  6A 12
39 01 00 00 00 00 02  6B 0E
39 01 00 00 00 00 02  6C 11
39 01 00 00 00 00 02  6D 0D
39 01 00 00 00 00 02  6E 10
39 01 00 00 00 00 02  6F 0C
39 01 00 00 00 00 02  70 14
39 01 00 00 00 00 02  71 15
39 01 00 00 00 00 02  72 08
39 01 00 00 00 00 02  73 01
39 01 00 00 00 00 02  74 00
39 01 00 00 00 00 02  75 02
39 01 00 00 00 00 02  76 02	
39 01 00 00 10 00 02  83 01
39 01 00 00 00 00 04  FF 61 36 01
39 01 00 00 00 00 02  A0 0E
39 01 00 00 00 00 02  A1 0C
39 01 00 00 00 00 02  A2 15
39 01 00 00 00 00 02  A3 1E
39 01 00 00 00 00 02  A4 16
39 01 00 00 00 00 02  A5 1D
39 01 00 00 00 00 02  A6 1F
39 01 00 00 00 00 02  A7 20
39 01 00 00 00 00 02  A8 24
39 01 00 00 00 00 02  A9 29
39 01 00 00 00 00 02  AA 2E
39 01 00 00 00 00 02  AB 36
39 01 00 00 00 00 02  AC 36
39 01 00 00 00 00 02  AD 2E
39 01 00 00 00 00 02  AE 2F
39 01 00 00 00 00 02  AF 2D		
39 01 00 00 00 00 02  B0 33
39 01 00 00 00 00 04  FF 61 36 01
39 01 00 00 00 00 02  C0 0C
39 01 00 00 00 00 02  C1 13
39 01 00 00 00 00 02  C2 17
39 01 00 00 00 00 02  C3 1E
39 01 00 00 00 00 02  C4 15
39 01 00 00 00 00 02  C5 19
39 01 00 00 00 00 02  C6 1D
39 01 00 00 00 00 02  C7 1D
39 01 00 00 00 00 02  C8 25
39 01 00 00 00 00 02  C9 2A
39 01 00 00 00 00 02  CA 31
39 01 00 00 00 00 02  CB 38
39 01 00 00 00 00 02  CC 38
39 01 00 00 00 00 02  CD 2F
39 01 00 00 00 00 02  CE 2C
39 01 00 00 00 00 02  CF 34
39 01 00 00 00 00 02  D0 34
39 01 00 00 00 00 04  FF 61 36 08
39 01 00 00 10 00 02  AB 24
39 01 00 00 00 00 04  FF 61 36 00
39 01 00 00 00 00 02  51 FF
39 01 00 00 00 00 04  FF 61 36 00
39 01 00 00 00 00 02  53 2c
39 01 00 00 00 00 04  FF 61 36 00
39 01 00 00 00 00 02  55 01
39 01 00 00 00 00 04  FF 61 36 00
05 01 00 00 96 00 02  11 00
39 01 00 00 00 00 04  FF 61 36 00
05 01 00 00 96 00 02  29 00
		];
		qcom,mdss-dsi-off-command = [
			05 01 00 00 28 00 02 28 00
			05 01 00 00 78 00 02 10 00
		];
		qcom,mdss-dsi-on-command-state = "dsi_lp_mode";
		qcom,mdss-dsi-off-command-state = "dsi_lp_mode";
		qcom,mdss-dsi-h-sync-pulse = <1>;
		qcom,mdss-dsi-traffic-mode = "2";//"non_burst_sync_pulse";
		qcom,mdss-dsi-lane-map = "0";//"lane_map_0123";
		qcom,mdss-dsi-bllp-eof-power-mode;
		qcom,mdss-dsi-bllp-power-mode;
		qcom,mdss-dsi-lane-0-state;
		qcom,mdss-dsi-lane-1-state;
		qcom,mdss-dsi-lane-2-state;
		qcom,mdss-dsi-lane-3-state;
        qcom,mdss-dsi-panel-timings = [ 7B 1A 10 00 3C 42 14 1C 15 03 04 00 ];
		qcom,mdss-dsi-panel-orientation = "180";//for lcd rotate
		qcom,mdss-dsi-t-clk-post = <0x20>;
		qcom,mdss-dsi-t-clk-pre = <0x3e>;
		qcom,mdss-dsi-bl-min-level = <1>;
		qcom,mdss-dsi-bl-max-level = <255>;
		qcom,mdss-dsi-dma-trigger = "4";//"trigger_sw";
		qcom,mdss-dsi-mdp-trigger = "0";//"none";
		qcom,mdss-pan-bl-levels = <1 255>;
		qcom,mdss-dsi-bl-pmic-control-type = "bl_ctrl_i2c";
		qcom,mdss-dsi-reset-sequence = <1 20>, <0 20>, <1 120>;     
	};
};

