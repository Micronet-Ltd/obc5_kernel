/* Copyright (c) 2013, The Linux Foundation. All rights reserved.
 *
 * This program is free software; you can redistribute it and/or modify
 * it under the terms of the GNU General Public License version 2 and
 * only version 2 as published by the Free Software Foundation.
 *
 * This program is distributed in the hope that it will be useful,
 * but WITHOUT ANY WARRANTY; without even the implied warranty of
 * MERCHANTABILITY or FITNESS FOR A PARTICULAR PURPOSE.  See the
 * GNU General Public License for more details.
 */

/*---------------------------------------------------------------------------
 * This file is autogenerated file using gcdb parser. Please do not edit it.
 * Update input XML file to add a new entry or update variable in this file
 * VERSION = "1.0"
 *---------------------------------------------------------------------------*/
&mdss_mdp {
	dsi_booyi_otm1901_auo5p5_1080_vid: qcom,mdss_dsi_booyi_otm1901_auo5p5_1080p_video {
		qcom,mdss-dsi-panel-name = "booyi otm1901 1080p auo video mode dsi panel";
		qcom,mdss-dsi-panel-controller = <&mdss_dsi0>;
		qcom,mdss-dsi-panel-type = "dsi_video_mode";
		qcom,mdss-dsi-panel-destination = "display_1";
		qcom,mdss-dsi-panel-framerate = <60>;
		qcom,mdss-dsi-virtual-channel-id = <0>;
		qcom,mdss-dsi-stream = <0>;
		qcom,mdss-dsi-panel-width = <1080>;
		qcom,mdss-dsi-panel-height = <1920>;
		qcom,mdss-dsi-h-front-porch = <36>;//32-12 100-->180
		qcom,mdss-dsi-h-back-porch = <28>;//32-->80-->8
		qcom,mdss-dsi-h-pulse-width = <4>;
		qcom,mdss-dsi-h-sync-skew = <0>;
		qcom,mdss-dsi-v-back-porch = <2>;
		qcom,mdss-dsi-v-front-porch = <3>;
		qcom,mdss-dsi-v-pulse-width = <2>;
		qcom,mdss-dsi-h-left-border = <0>;
		qcom,mdss-dsi-h-right-border = <0>;
		qcom,mdss-dsi-v-top-border = <0>;
		qcom,mdss-dsi-v-bottom-border = <0>;
		qcom,mdss-dsi-bpp = <24>;
		qcom,mdss-dsi-underflow-color = <0xff>;
		qcom,mdss-dsi-border-color = <0>;
		qcom,mdss-dsi-on-command = [
39 01 00 00 00 00 02 00 00
39 01 00 00 00 00 05 FF 19 01 01 00
39 01 00 00 00 00 02 00 80
39 01 00 00 00 00 03 FF 19 01
//Bypass
39 01 00 00 00 00 02 00 00
39 01 00 00 00 00 02 1C 33//Can not OTP
39 01 00 00 00 00 02 00 A0
39 01 00 00 00 00 02 C1 E8
//For compression -->BP Offset Fixed Code
39 01 00 00 00 00 02 00 A7
39 01 00 00 00 00 02 C1 00
//Shift1 2 3 -->Shift Fixed Code
39 01 00 00 00 00 02 00 90
39 01 00 00 00 00 07 C0 00 2F 00 00 00 01
//Shift1 2 3 -->Shift Fixed Code
39 01 00 00 00 00 02 00 C0
39 01 00 00 00 00 07 C0 00 2F 00 00 00 01
39 01 00 00 00 00 02 00 9A
39 01 00 00 00 00 02 C0 1E
39 01 00 00 00 00 02 00 AC
39 01 00 00 00 00 02 C0 06
39 01 00 00 00 00 02 00 DC
39 01 00 00 00 00 02 C0 06
39 01 00 00 00 00 02 00 81
39 01 00 00 00 00 02 A5 04
//Enable Gamma Calibration&Enable Gamma Chop
39 01 00 00 00 00 02 00 92
39 01 00 00 00 00 02 E9 00
//Enable RESET=low LVD
39 01 00 00 00 00 02 00 90
39 01 00 00 00 00 02 F3 01
//[Setting by Panel]
//VGH=9V
39 01 00 00 00 00 02 00 93
39 01 00 00 00 00 02 C5 1E
//VGL=-9V
39 01 00 00 00 00 02 00 95
39 01 00 00 00 00 02 C5 32
//VGHO=8.5V
39 01 00 00 00 00 02 00 97
39 01 00 00 00 00 02 C5 19
//VGLO=-8.5V
39 01 00 00 00 00 02 00 99
39 01 00 00 00 00 02 C5 2D
//GVDD/NGVDD=4.4V
39 01 00 00 00 00 02 00 00
39 01 00 00 00 00 03 D8 1F 1F
//Pixel base column inversion
39 01 00 00 00 00 02 00 B3
39 01 00 00 00 00 02 C0 CC
39 01 00 00 00 00 02 00 BC
39 01 00 00 00 00 02 C0 CC
//power off 2=ltps toggle, source=black, VCOM
//power off 1=ltps toggle, source=GND, VCOM=GND
//power off 1=ltps discharge, source=GND, VCOM=GND
39 01 00 00 00 00 02 00 CD//ltps power
39 01 00 00 00 00 02 F5 19//reg_analog_en_ltps_pwr_sel_l
39 01 00 00 00 00 02 00 DB
39 01 00 00 00 00 02 F5 19//reg_analog_gs_en_lsh_sel_l
39 01 00 00 00 00 02 00 F5
39 01 00 00 00 00 02 C1 40//reg_ltps_gdpch_avdd=1'b0=c1f6[6]
39 01 00 00 00 00 02 00 B9//enable power off 2 frame
39 01 00 00 00 00 02 C0 11//reg_tcon_f_powof_2=2'h0=c0ba[1:0]
39 01 00 00 00 00 02 00 8D//VCOM shift
39 01 00 00 00 00 02 F5 20//reg_analog_en_vcom_sel_l
39 01 00 00 00 00 02 00 80
39 01 00 00 00 00 0F C0 00 87 00 04 06 00 87 04 06 00 87 00 04 06
39 01 00 00 00 00 02 00 F0
39 01 00 00 00 00 07 C3 00 00 00 00 00 80
39 01 00 00 00 00 02 00 A0
39 01 00 00 00 00 08 C0 00 00 0C 00 00 1D 06
39 01 00 00 00 00 02 00 D0
39 01 00 00 00 00 08 C0 00 00 0C 00 00 1D 06
39 01 00 00 00 00 02 00 90
39 01 00 00 00 00 05 C2 84 01 45 45
39 01 00 00 00 00 02 00 80
39 01 00 00 00 00 0D C3 85 03 03 01 00 02 83 04 03 01 00 02
39 01 00 00 00 00 02 00 90
39 01 00 00 00 00 0D C3 84 04 03 01 00 02 82 04 03 01 00 02
39 01 00 00 00 00 02 00 80
39 01 00 00 00 00 10 CC 09 0A 11 12 13 14 15 16 17 18 28 28 28 28 28
39 01 00 00 00 00 02 00 90
39 01 00 00 00 00 10 CC 09 0A 14 13 12 11 18 17 16 15 28 28 28 28 28
39 01 00 00 00 00 02 00 A0
39 01 00 00 00 00 10 CC 1D 1E 1F 19 1A 1B 1C 20 21 22 23 24 25 26 27
39 01 00 00 00 00 02 00 B0
39 01 00 00 00 00 09 CC 01 02 03 05 06 07 04 08
39 01 00 00 00 00 02 00 C0
39 01 00 00 00 00 0D CC 00 00 00 00 00 00 00 00 00 00 00 70
39 01 00 00 00 00 02 00 D0
39 01 00 00 00 00 0D CC C0 0C 00 00 05 C0 00 00 33 03 00 70
39 01 00 00 00 00 02 00 80//modify CLK=CKV1=CB82=FF->00, XCLK=CKV4=CB85=00->FF
39 01 00 00 00 00 10 CB 00 00 00 00 00 00 00 00 00 00 00 00 00 00 00
39 01 00 00 00 00 02 00 90
39 01 00 00 00 00 10 CB 00 00 FF 00 00 00 00 FF 00 00 00 00 00 00 00
39 01 00 00 00 00 02 00 A0
39 01 00 00 00 00 10 CB 15 00 05 F5 05 F5 00 00 00 00 00 00 00 00 00
39 01 00 00 00 00 02 00 B0
39 01 00 00 00 00 10 CB 00 01 FD 00 00 00 00 FF 00 00 00 00 00 00 00
39 01 00 00 00 00 02 00 C0
39 01 00 00 00 00 09 CB 00 00 00 00 00 00 00 77
39 01 00 00 00 00 02 00 D0
39 01 00 00 00 00 09 CB 00 00 00 00 00 00 00 77
39 01 00 00 00 00 02 00 E0
39 01 00 00 00 00 09 CB 00 00 00 00 00 00 00 77
39 01 00 00 00 00 02 00 F0
39 01 00 00 00 00 09 CB 11 11 11 00 00 00 00 77
39 01 00 00 00 00 02 00 80
39 01 00 00 00 00 10 CD 3F 3F 3F 3F 3F 3F 3F 3F 01 12 11 03 04 3F 17
39 01 00 00 00 00 02 00 90
39 01 00 00 00 00 0C CD 18 3F 3D 25 25 25 1F 20 21 26 26
39 01 00 00 00 00 02 00 A0
39 01 00 00 00 00 10 CD 3F 3F 3F 3F 3F 3F 3F 3F 01 12 11 05 06 3F 17
39 01 00 00 00 00 02 00 B0
39 01 00 00 00 00 0C CD 18 3F 3D 25 25 25 1F 20 21 26 26
//---------------- for Power IC Mode ------------------------//
39 01 00 00 00 00 02 00 C2
39 01 00 00 00 00 02 C5 12
39 01 00 00 00 00 02 00 A8
39 01 00 00 00 00 02 C4 12
39 01 00 00 00 00 02 00 A0
39 01 00 00 00 00 05 C4 30 26 04 3A
39 01 00 00 00 00 02 00 A4
39 01 00 00 00 00 05 C4 30 26 84 3A
39 01 00 00 00 00 02 00 E1
39 01 00 00 00 00 02 F5 45
39 01 00 00 00 00 02 00 00
39 01 00 00 00 00 02 51 00
39 01 00 00 00 00 02 00 00
39 01 00 00 00 00 02 53 2c
39 01 00 00 00 00 02 00 00
39 01 00 00 00 00 02 55 01
//--------------------------------------------------------------//
//[Fixed]
39 01 00 00 00 00 02 00 00
39 01 00 00 00 00 04 FF FF FF FF
39 01 00 00 96 00 02 11 00
39 01 00 00 32 00 02 29 00
];
		qcom,mdss-dsi-off-command = [05 01 00 00 32 00 02 28 00
					05 01 00 00 78 00 02 10 00];
		qcom,mdss-dsi-on-command-state = "dsi_lp_mode";
		qcom,mdss-dsi-off-command-state = "dsi_hs_mode";
		qcom,mdss-dsi-h-sync-pulse = <1>;
		qcom,mdss-dsi-traffic-mode = "burst_mode";
		qcom,mdss-dsi-bllp-eof-power-mode;
		qcom,mdss-dsi-bllp-power-mode;
		qcom,mdss-dsi-lane-0-state;
		qcom,mdss-dsi-lane-1-state;
		qcom,mdss-dsi-lane-2-state;
		qcom,mdss-dsi-lane-3-state;
		qcom,mdss-dsi-panel-timings = [f9 3d 34 00 58 4d 36 3f 53 03 04 00];
		qcom,mdss-dsi-t-clk-post = <0x1e>;
		qcom,mdss-dsi-t-clk-pre = <0x38>;
		qcom,mdss-dsi-bl-min-level = <0>;
		qcom,mdss-dsi-bl-max-level = <255>;
		qcom,mdss-dsi-dma-trigger = <4>;
		qcom,mdss-dsi-mdp-trigger = <0>;
		qcom,mdss-pan-bl-levels = <1 255>;
		qcom,mdss-dsi-bl-pmic-control-type = "bl_ctrl_dcs";
		//qcom,mdss-dsi-bl-pmic-bank-select = <0>;
		//qcom,mdss-dsi-bl-pmic-pwm-frequency = <270>; 
		//qcom,mdss-dsi-pwm-gpio = <&pm8916_mpps 4 0>;
		qcom,mdss-dsi-reset-sequence = <1 50>, <0 50>, <1 120>;
	};
};
