/* Copyright (c) 2013, The Linux Foundation. All rights reserved.
 *
 * This program is free software; you can redistribute it and/or modify
 * it under the terms of the GNU General Public License version 2 and
 * only version 2 as published by the Free Software Foundation.
 *
 * This program is distributed in the hope that it will be useful,
 * but WITHOUT ANY WARRANTY; without even the implied warranty of
 * MERCHANTABILITY or FITNESS FOR A PARTICULAR PURPOSE.  See the
 * GNU General Public License for more details.
 */

/*---------------------------------------------------------------------------
 * This file is autogenerated file using gcdb parser. Please do not edit it.
 * Update input XML file to add a new entry or update variable in this file
 * VERSION = "1.0"
 *---------------------------------------------------------------------------*/
&mdss_mdp {
	dsi_st7703_hd_hxgd_5p5_hd_vid: qcom,mdss_dsi_st7703_hd_hxgd_5p5_hd_video {
		qcom,mdss-dsi-panel-name = "mdss_dsi_st7703_hd_hxgd_5p5_hd_video";
		qcom,mdss-dsi-panel-controller = <&mdss_dsi0>;
		qcom,mdss-dsi-panel-type = "dsi_video_mode";
		qcom,mdss-dsi-panel-destination = "display_1";
		qcom,mdss-dsi-panel-framerate = <60>;
		qcom,mdss-dsi-virtual-channel-id = <0>;
		qcom,mdss-dsi-stream = <0>;
		qcom,mdss-dsi-panel-width = <720>;
		qcom,mdss-dsi-panel-height = <1280>;
		qcom,mdss-dsi-h-front-porch = <50>;
		qcom,mdss-dsi-h-back-porch = <50>;
		qcom,mdss-dsi-h-pulse-width = <8>;
		qcom,mdss-dsi-h-sync-skew = <0>;
		qcom,mdss-dsi-v-back-porch = <50>;
		qcom,mdss-dsi-v-front-porch = <50>;
		qcom,mdss-dsi-v-pulse-width = <8>;
		qcom,mdss-dsi-h-left-border = <0>;
		qcom,mdss-dsi-h-right-border = <0>;
		qcom,mdss-dsi-v-top-border = <0>;
		qcom,mdss-dsi-v-bottom-border = <0>;
		qcom,mdss-dsi-bpp = <24>;
		qcom,mdss-dsi-underflow-color = <0xff>;
		qcom,mdss-dsi-border-color = <0>;
        qcom,mdss-dsi-on-command = [
			39 01 00 00 00 00 04 B9 F1 12 83 
			39 01 00 00 00 00 1C BA 33 81 05 F9 0e 0e 02 00 00 00 00 00 00 00 44 25 00 91 0a 00 00 02 4F 11 00 00 37 
			39 01 00 00 00 00 02 B8 25 		
			39 01 00 00 00 00 0B B3 10 10 05 05 03 FF 00 00 00 00 
			39 01 00 00 00 00 0A C0 70 73 50 50 00 00 08 70 00 
			39 01 00 00 00 00 02 BC 4E 
			39 01 00 00 00 00 02 CC 0B 
			39 01 00 00 00 00 02 B4 80 
			39 01 00 00 00 00 04 B2 C8 02 30 	
			39 01 00 00 00 00 0F E3 07 07 0B 0B 03 0B 00 00 00 00 FF 80 C0 10 
			39 01 00 00 00 00 0D C1 54 C0 1E 1E 77 E1 FF FF CC CC 77 77 
			39 01 00 00 00 00 03 B5 07 07 
			39 01 00 00 00 00 03 B6 30 30 
			39 01 00 00 00 00 04 BF 02 11 00 
			39 01 00 00 00 00 40 E9 C2 10 04 05 00 0A A0 12 31 23 37 82 40 A0 27 38 0C 00 03 00 00 00 0C 00 03 00 00 00 75 75 31 88 88 88 88 88 88 13 88 64 64 20 88 88 88 88 88 88 02 88 00 00 00 00 00 00 00 00 00 00 00 00 00 
			39 01 00 00 00 00 3E EA 02 21 00 00 00 00 00 00 00 00 00 00 02 46 02 88 88 88 88 88 88 64 88 13 57 13 88 88 88 88 88 88 75 88 23 10 00 00 30 00 00 00 00 00 00 00 00 00 00 00 00 00 00 00 30 0A A0 00 00 00 00 
			39 01 00 00 00 00 23 E0 00 0B 0E 28 32 3C 40 31 08 0C 0D 10 11 0F 11 10 10 00 0B 0E 28 32 3C 40 31 08 0C 0D 10 11 0F 11 10 10 
			39 01 00 00 00 00 03 C7 A0 00 
			39 01 00 00 00 00 05 C8 01 02 04 02  	
			39 01 00 00 00 00 02 53 24 
			39 01 00 00 00 00 02 55 01
			29 01 00 00 C8 00 02 11 00
			29 01 00 00 78 00 02 29 00
		];
qcom,mdss-dsi-off-command = [
05 01 00 00 0a 00 02 28 00
05 01 00 00 96 00 02 10 00
];
	qcom,mdss-dsi-on-command-state = "dsi_lp_mode";
	qcom,mdss-dsi-off-command-state = "dsi_hs_mode";
	qcom,mdss-dsi-h-sync-pulse = <1>;
	qcom,mdss-dsi-traffic-mode = <2>;
	qcom,mdss-dsi-lane-map = <0>;
	qcom,mdss-dsi-bllp-eof-power-mode;
	qcom,mdss-dsi-bllp-power-mode;
	qcom,mdss-dsi-lane-0-state;
	qcom,mdss-dsi-lane-1-state;
	qcom,mdss-dsi-lane-2-state;
	qcom,mdss-dsi-lane-3-state;
	qcom,mdss-dsi-panel-timings = [E7 36 24 00 66 6A 2A 3A 2D 03 04 00];
	qcom,mdss-dsi-t-clk-post = <0x03>;
	qcom,mdss-dsi-t-clk-pre = <0x35>;
	qcom,mdss-dsi-bl-min-level = <0>;
	qcom,mdss-dsi-bl-max-level = <255>;
	qcom,mdss-dsi-dma-trigger = <4>;
	qcom,mdss-dsi-mdp-trigger = <0>;
	qcom,mdss-pan-bl-levels = <1 255>;
	qcom,mdss-dsi-bl-pmic-control-type = "bl_ctrl_pwm";
	qcom,mdss-dsi-bl-pmic-bank-select = <0>;
	qcom,mdss-dsi-bl-pmic-pwm-frequency = <270>; 
	qcom,mdss-dsi-pwm-gpio = <&pm8916_mpps 4 0>;
	qcom,mdss-dsi-reset-sequence = <1 50>, <0 50>, <1 120>;
	};
};
