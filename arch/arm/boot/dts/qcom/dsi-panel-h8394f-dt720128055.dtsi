/* Copyright (c) 2014-2015, The Linux Foundation. All rights reserved.
 *
 * This program is free software; you can redistribute it and/or modify
 * it under the terms of the GNU General Public License version 2 and
 * only version 2 as published by the Free Software Foundation.
 *
 * This program is distributed in the hope that it will be useful,
 * but WITHOUT ANY WARRANTY; without even the implied warranty of
 * MERCHANTABILITY or FITNESS FOR A PARTICULAR PURPOSE.  See the
 * GNU General Public License for more details.
 */

/*---------------------------------------------------------------------------
 * This file is autogenerated file using gcdb parser. Please do not edit it.
 * Update input XML file to add a new entry or update variable in this file
 * VERSION = "1.0"
 *---------------------------------------------------------------------------*/
&mdss_mdp {
    dsi_h8394f_dt720128055_hd_video: qcom,mdss_h8394f_dt720128055_hd_video {
        qcom,mdss-dsi-panel-name = "mdss_h8394f_dt720128055_hd_video";
		qcom,mdss-dsi-panel-controller = <&mdss_dsi0>;
		qcom,mdss-dsi-panel-type = "dsi_video_mode";
		qcom,mdss-dsi-panel-destination = "display_1";
		qcom,mdss-dsi-panel-framerate = <60>;
		qcom,mdss-dsi-virtual-channel-id = <0>;
		qcom,mdss-dsi-stream = <0>;
		qcom,mdss-dsi-panel-width = <720>;
		qcom,mdss-dsi-panel-height = <1280>;
		qcom,mdss-dsi-h-front-porch = <100>;
		qcom,mdss-dsi-h-back-porch = <100>;
		qcom,mdss-dsi-h-pulse-width = <8>;
		qcom,mdss-dsi-h-sync-skew = <0>;
		qcom,mdss-dsi-v-back-porch = <14>;
		qcom,mdss-dsi-v-front-porch = <20>;
		qcom,mdss-dsi-v-pulse-width = <1>;
		qcom,mdss-dsi-h-left-border = <0>;
		qcom,mdss-dsi-h-right-border = <0>;
		qcom,mdss-dsi-v-top-border = <0>;
		qcom,mdss-dsi-v-bottom-border = <0>;
		qcom,mdss-dsi-bpp = <24>;
		qcom,mdss-dsi-underflow-color = <0xff>;
		qcom,mdss-dsi-border-color = <0>;
        qcom,mdss-dsi-on-command = [
39 01 00 00 00 00 04 B9 FF 83 94
39 01 00 00 00 00 07 BA 33 83 68 6B B2 C0
39 01 00 00 00 00 0B B1 48 12 72 09 33 41 71 51 50 3B
39 01 00 00 00 00 07 B2 00 80 64 0E 0D 2F
39 01 00 00 00 00 16 B4 03 74 23 74 23 7C 01 0C 86 75 00 3F 03 74 23 74 23 74 01 0C 86
39 01 00 00 00 00 22 D3 00 00 07 07 00 00 08 08 32 10 09 00 09 32 15 0D 05 0D 32 10 08 00 00 37 33 0C 0C 27 02 02 27 0E 40
39 01 00 00 00 00 2D D5 27 26 25 24 07 06 05 04 03 02 01 00 18 18 18 18 18 18 18 18 18 18 18 18 18 18 18 18 18 18 18 18 18 18 18 18 21 20 23 22 18 18 18 18
39 01 00 00 00 00 2D D6 20 21 22 23 04 05 06 07 00 01 02 03 18 18 18 18 18 18 18 18 18 18 18 18 18 18 18 18 18 18 18 18 18 18 18 18 26 27 24 25 18 18 18 18
39 01 00 00 00 00 3B E0 00 0B 1B 25 2A 30 34 34 6C 7D 8E 8B 8D 9B 9A 97 A0 9F 99 A7 B5 59 58 5C 60 61 67 72 7F 00 0B 1B 25 2A 30 34 34 6C 7D 8E 8B 8D 9A 99 95 A0 9E 99 A6 B4 59 58 5C 60 62 68 73 7F
39 01 00 00 00 00 03 B6 46 46
15 01 00 00 00 00 02 CC 0B
39 01 00 00 00 00 03 C0 1F 31
15 01 00 00 00 00 02 D4 02
15 01 00 00 00 00 02 BD 01
15 01 00 00 00 00 02 B1 00
15 01 00 00 00 00 02 BD 00
39 01 00 00 00 00 08 BF 40 81 50 00 1A FC 01
15 01 00 00 00 00 02 C6 EF
05 01 00 00 00 00 01 11
05 01 00 00 00 00 01 29
];
qcom,mdss-dsi-off-command = [
05 01 00 00 0a 00 02 28 00
05 01 00 00 96 00 02 10 00
];
	qcom,mdss-dsi-on-command-state = "dsi_lp_mode";
	qcom,mdss-dsi-off-command-state = "dsi_hs_mode";
	qcom,mdss-dsi-h-sync-pulse = <1>;
	qcom,mdss-dsi-traffic-mode = <2>;
	qcom,mdss-dsi-lane-map = <0>;
	qcom,mdss-dsi-bllp-eof-power-mode;
	qcom,mdss-dsi-bllp-power-mode;
	qcom,mdss-dsi-lane-0-state;
	qcom,mdss-dsi-lane-1-state;
	qcom,mdss-dsi-lane-2-state;
	qcom,mdss-dsi-lane-3-state;
	qcom,mdss-dsi-panel-timings = [E7 36 24 00 66 6A 2A 3A 2D 03 04 00];
	qcom,mdss-dsi-t-clk-post = <0x03>;
	qcom,mdss-dsi-t-clk-pre = <0x35>;
	qcom,mdss-dsi-bl-min-level = <0>;
	qcom,mdss-dsi-bl-max-level = <255>;
	qcom,mdss-dsi-dma-trigger = <4>;
	qcom,mdss-dsi-mdp-trigger = <0>;
	qcom,mdss-pan-bl-levels = <1 255>;
	qcom,mdss-dsi-bl-pmic-control-type = "bl_ctrl_pwm";
	qcom,mdss-dsi-bl-pmic-bank-select = <0>;
	qcom,mdss-dsi-bl-pmic-pwm-frequency = <270>; 
	qcom,mdss-dsi-pwm-gpio = <&pm8916_mpps 4 0>;
	qcom,mdss-dsi-reset-sequence = <1 50>, <0 50>, <1 120>;
	};
};