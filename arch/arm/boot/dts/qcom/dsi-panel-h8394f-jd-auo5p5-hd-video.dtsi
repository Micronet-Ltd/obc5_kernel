/* Copyright (c) 2013, The Linux Foundation. All rights reserved.
 *
 * This program is free software; you can redistribute it and/or modify
 * it under the terms of the GNU General Public License version 2 and
 * only version 2 as published by the Free Software Foundation.
 *
 * This program is distributed in the hope that it will be useful,
 * but WITHOUT ANY WARRANTY; without even the implied warranty of
 * MERCHANTABILITY or FITNESS FOR A PARTICULAR PURPOSE.  See the
 * GNU General Public License for more details.
 */

/*---------------------------------------------------------------------------
 * This file is autogenerated file using gcdb parser. Please do not edit it.
 * Update input XML file to add a new entry or update variable in this file
 * VERSION = "1.0"
 *---------------------------------------------------------------------------*/
&mdss_mdp {
	dsi_h8394f_jd_auo5p5_hd_vid: qcom,mdss_dsi_h8394f_jd_auo5p5_hd_video {
		qcom,mdss-dsi-panel-name = "mdss_dsi_h8394f_jd_auo5p5_hd_video";
		qcom,mdss-dsi-panel-controller = <&mdss_dsi0>;
		qcom,mdss-dsi-panel-type = "dsi_video_mode";
		qcom,mdss-dsi-panel-destination = "display_1";
		qcom,mdss-dsi-panel-framerate = <60>;
		qcom,mdss-dsi-virtual-channel-id = <0>;
		qcom,mdss-dsi-stream = <0>;
		qcom,mdss-dsi-panel-width = <720>;
		qcom,mdss-dsi-panel-height = <1280>;
		qcom,mdss-dsi-h-front-porch = <100>;
		qcom,mdss-dsi-h-back-porch = <100>;
		qcom,mdss-dsi-h-pulse-width = <8>;
		qcom,mdss-dsi-h-sync-skew = <0>;
		qcom,mdss-dsi-v-back-porch = <20>;
		qcom,mdss-dsi-v-front-porch = <14>;
		qcom,mdss-dsi-v-pulse-width = <1>;
		qcom,mdss-dsi-h-left-border = <0>;
		qcom,mdss-dsi-h-right-border = <0>;
		qcom,mdss-dsi-v-top-border = <0>;
		qcom,mdss-dsi-v-bottom-border = <0>;
		qcom,mdss-dsi-bpp = <24>;
		qcom,mdss-dsi-underflow-color = <0xff>;
		qcom,mdss-dsi-border-color = <0>;
        qcom,mdss-dsi-on-command = [
//SET EXTC
39 01 00 00 00 00 04 B9 FF 83 94  
//Set MIPI
39 01 00 00 10 00 07 BA 63 03 68 6b b2 c0
//FOR 5186 MODE
39 01 00 00 10 00 0B B1 48 12 72 09 32 44 71 31 4F 35
//set Display
39 01 00 00 00 00 06 B2 65 80 64 05 07
//set CYC
39 01 00 00 20 00 1F B4 26 76 26 76 26 26 05 10 86 35 00 3f 26 76 26 76 26 26 05 10 86 3f 00 ff 81 81 81 81 08 01
//set VCOM
39 01 00 00 00 00 03 B6 34 34 
//set GIP
39 01 00 00 20 00 22 D3 00 00 0F 0F 01 01 10 10 32 10 00 00 00 32 15 04 05 04 32 15 14 05 14 37 33 04 04 37 00 00 47 05 40
//Set Forward GIP
39 01 00 00 00 00 2D D5 18 18 25 24 27 26 11 10 15 14 13 12 17 16 01 00 18 18 18 18 18 18 18 18 18 18 05 04 03 02 07 06 18 18 18 18 21 20 23 22 18 18 18 18
//Set Backward GIP
39 01 00 00 20 00 2D D6 18 18 22 23 20 21 21 13 16 17 10 11 14 15 06 07 18 18 18 18 18 18 18 18 18 18 02 03 04 05 00 01 18 18 18 18 26 27 24 25 18 18 18 18
//gamma 2.2
39 01 00 00 20 00 3B E0 00 03 0B 0E 10 13 17 15 2D 3D 51 51 5E 75 7C 84 94 9A 98 A6 B2 57 57 5A 60 64 6A 72 7F 00 03 0B 0E 10 13 17 15 2D 3D 51 51 5E 75 7C 84 94 9A 98 A6 B2 57 57 5A 60 64 6A 72 7F 
//Set C0
39 01 00 00 00 00 03 C0 1F 31
//set Panel
39 01 00 00 00 00 02 CC 0B
//set D2
39 01 00 00 00 00 02 D2 88
//set D4 // Set EMI enhance
39 01 00 00 00 00 02 D4 02
//set BD
39 01 00 00 00 00 02 BD 01
//set B1
39 01 00 00 00 00 02 B1 60
//set BD
39 01 00 00 00 00 02 BD 00
//set POWER HX5186C
39 01 00 00 00 00 08 BF 40 81 50 00 1A FC 01
29 01 00 00 C8 00 02 11 00
29 01 00 00 78 00 02 29 00
//05 01 00 00 c8 00 02 11 00
//05 01 00 00 0a 00 02 29 00
];
qcom,mdss-dsi-off-command = [
05 01 00 00 0a 00 02 28 00
05 01 00 00 96 00 02 10 00
];
	qcom,mdss-dsi-on-command-state = "dsi_lp_mode";
	qcom,mdss-dsi-off-command-state = "dsi_hs_mode";
	qcom,mdss-dsi-h-sync-pulse = <1>;
	qcom,mdss-dsi-traffic-mode = <2>;
	qcom,mdss-dsi-lane-map = <0>;
	qcom,mdss-dsi-bllp-eof-power-mode;
	qcom,mdss-dsi-bllp-power-mode;
	qcom,mdss-dsi-lane-0-state;
	qcom,mdss-dsi-lane-1-state;
	qcom,mdss-dsi-lane-2-state;
	qcom,mdss-dsi-lane-3-state;
	qcom,mdss-dsi-panel-timings = [E7 36 24 00 66 6A 2A 3A 2D 03 04 00];
	qcom,mdss-dsi-t-clk-post = <0x03>;
	qcom,mdss-dsi-t-clk-pre = <0x35>;
	qcom,mdss-dsi-bl-min-level = <0>;
	qcom,mdss-dsi-bl-max-level = <255>;
	qcom,mdss-dsi-dma-trigger = <4>;
	qcom,mdss-dsi-mdp-trigger = <0>;
	qcom,mdss-pan-bl-levels = <1 255>;
	qcom,mdss-dsi-bl-pmic-control-type = "bl_ctrl_pwm";
	qcom,mdss-dsi-bl-pmic-bank-select = <0>;
	qcom,mdss-dsi-bl-pmic-pwm-frequency = <270>; 
	qcom,mdss-dsi-pwm-gpio = <&pm8916_mpps 4 0>;
	qcom,mdss-dsi-reset-sequence = <1 50>, <0 50>, <1 120>;
	};
};
