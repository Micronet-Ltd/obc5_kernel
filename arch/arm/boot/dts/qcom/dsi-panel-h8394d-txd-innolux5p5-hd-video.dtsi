/* Copyright (c) 2013, The Linux Foundation. All rights reserved.
 *
 * This program is free software; you can redistribute it and/or modify
 * it under the terms of the GNU General Public License version 2 and
 * only version 2 as published by the Free Software Foundation.
 *
 * This program is distributed in the hope that it will be useful,
 * but WITHOUT ANY WARRANTY; without even the implied warranty of
 * MERCHANTABILITY or FITNESS FOR A PARTICULAR PURPOSE.  See the
 * GNU General Public License for more details.
 */

/*---------------------------------------------------------------------------
 * This file is autogenerated file using gcdb parser. Please do not edit it.
 * Update input XML file to add a new entry or update variable in this file
 * VERSION = "1.0"
 *---------------------------------------------------------------------------*/
&mdss_mdp {
	dsi_h8394d_txd_innolux5p5_hd_vid: qcom,mdss_dsi_h8394d_txd_innolux5p5_hd_video {
		qcom,mdss-dsi-panel-name = "mdss_dsi_h8394d_txd_innolux5p5_hd_video";
		qcom,mdss-dsi-panel-controller = <&mdss_dsi0>;
		qcom,mdss-dsi-panel-type = "dsi_video_mode";
		qcom,mdss-dsi-panel-destination = "display_1";
		qcom,mdss-dsi-panel-framerate = <60>;
		qcom,mdss-dsi-virtual-channel-id = <0>;
		qcom,mdss-dsi-stream = <0>;
		qcom,mdss-dsi-panel-width = <720>;
		qcom,mdss-dsi-panel-height = <1280>;
		qcom,mdss-dsi-h-front-porch = <100>;
		qcom,mdss-dsi-h-back-porch = <100>;
		qcom,mdss-dsi-h-pulse-width = <8>;
		qcom,mdss-dsi-h-sync-skew = <0>;
		qcom,mdss-dsi-v-back-porch = <14>;
		qcom,mdss-dsi-v-front-porch = <20>;
		qcom,mdss-dsi-v-pulse-width = <1>;
		qcom,mdss-dsi-h-left-border = <0>;
		qcom,mdss-dsi-h-right-border = <0>;
		qcom,mdss-dsi-v-top-border = <0>;
		qcom,mdss-dsi-v-bottom-border = <0>;
		qcom,mdss-dsi-bpp = <24>;
		qcom,mdss-dsi-underflow-color = <0xff>;
		qcom,mdss-dsi-border-color = <0>;
        qcom,mdss-dsi-on-command = [
39 01 00 00 00 00 04 B9 FF 83 94
39 01 00 00 00 00 03 BA 33 83
39 01 00 00 00 00 10 B1 6C 0f 0f 34 04 11 F1 81 2e 9f 23 80 C0 D2 58
39 01 00 00 00 00 0C B2 00 64 0E 0D 32 1c 08 08 1C 4D 00
39 01 00 00 00 00 0D B4 00 FF 51 5A 59 5A 03 5A 01 6A 01 6A
39 01 00 00 00 00 26 D3 00 07 00 40 07 10 00 08 10 08 00 08 54 15 0e 05 0e 02 15 06 05 06 47 44 0a 0a 4b 10 07 07 08 00 00 00 0A 00 01
39 01 00 00 00 00 2D D5 1a 1a 1b 1b 00 01 02 03 04 05 06 07 08 09 0a 0b 24 25 18 18 26 27 18 18 18 18 18 18 18 18 18 18 18 18 18 18 18 18 20 21 18 18 18 18
39 01 00 00 00 00 2D D6 1a 1a 1b 1b 0b 0a 09 08 07 06 05 04 03 02 01 00 21 20 58 58 27 26 18 18 18 18 18 18 18 18 18 18 18 18 18 18 18 18 25 24 18 18 18 18
39 01 00 00 00 00 2B E0 00 05 0a 1e 1a 3f 16 34 06 0a 0c 17 0e 11 14 12 13 0a 13 14 16 00 05 0a 1e 1a 3f 16 34 06 0a 0c 17 0e 11 14 12 13 0a 13 14 16
39 01 00 00 00 00 02 CC 09 //01-->09
39 01 00 00 00 00 05 C7 00 C0 00 C0
39 01 00 00 00 00 03 B6 46 46
29 01 00 00 C8 00 02 11 00
29 01 00 00 78 00 02 29 00
];
qcom,mdss-dsi-off-command = [
05 01 00 00 0a 00 02 28 00
05 01 00 00 96 00 02 10 00
];
	qcom,mdss-dsi-on-command-state = "dsi_lp_mode";
	qcom,mdss-dsi-off-command-state = "dsi_hs_mode";
	qcom,mdss-dsi-h-sync-pulse = <1>;
	qcom,mdss-dsi-traffic-mode = <2>;
	qcom,mdss-dsi-lane-map = <0>;
	qcom,mdss-dsi-bllp-eof-power-mode;
	qcom,mdss-dsi-bllp-power-mode;
	qcom,mdss-dsi-lane-0-state;
	qcom,mdss-dsi-lane-1-state;
	qcom,mdss-dsi-lane-2-state;
	qcom,mdss-dsi-lane-3-state;
	qcom,mdss-dsi-panel-timings = [E7 36 24 00 66 6A 2A 3A 2D 03 04 00];
	qcom,mdss-dsi-t-clk-post = <0x03>;
	qcom,mdss-dsi-t-clk-pre = <0x35>;
	qcom,mdss-dsi-bl-min-level = <0>;
	qcom,mdss-dsi-bl-max-level = <255>;
	qcom,mdss-dsi-dma-trigger = <4>;
	qcom,mdss-dsi-mdp-trigger = <0>;
	qcom,mdss-pan-bl-levels = <1 255>;
	qcom,mdss-dsi-bl-pmic-control-type = "bl_ctrl_pwm";
	qcom,mdss-dsi-bl-pmic-bank-select = <0>;
	qcom,mdss-dsi-bl-pmic-pwm-frequency = <270>; 
	qcom,mdss-dsi-pwm-gpio = <&pm8916_mpps 4 0>;
	qcom,mdss-dsi-reset-sequence = <1 50>, <0 50>, <1 120>;
	};
};
