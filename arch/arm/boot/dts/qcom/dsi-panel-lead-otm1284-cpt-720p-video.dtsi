/* Copyright (c) 2013, The Linux Foundation. All rights reserved.
 *
 * This program is free software; you can redistribute it and/or modify
 * it under the terms of the GNU General Public License version 2 and
 * only version 2 as published by the Free Software Foundation.
 *
 * This program is distributed in the hope that it will be useful,
 * but WITHOUT ANY WARRANTY; without even the implied warranty of
 * MERCHANTABILITY or FITNESS FOR A PARTICULAR PURPOSE.  See the
 * GNU General Public License for more details.
 */

/*---------------------------------------------------------------------------
 * This file is autogenerated file using gcdb parser. Please do not edit it.
 * Update input XML file to add a new entry or update variable in this file
 * VERSION = "1.0"
 *---------------------------------------------------------------------------*/
&mdss_mdp {
	dsi_lead_otm1284_720p_cpt_vid: qcom,mdss_dsi_lead_otm1284_720p_cpt_video {
		qcom,mdss-dsi-panel-name = "mdss_dsi_lead_otm1284_720p_cpt_video";
		qcom,mdss-dsi-panel-controller = <&mdss_dsi0>;
		qcom,mdss-dsi-panel-type = "dsi_video_mode";
		qcom,mdss-dsi-panel-destination = "display_1";
		qcom,mdss-dsi-panel-framerate = <55>;
		qcom,mdss-dsi-virtual-channel-id = <0>;
		qcom,mdss-dsi-stream = <0>;
		qcom,mdss-dsi-panel-width = <720>;
		qcom,mdss-dsi-panel-height = <1280>;
		qcom,mdss-dsi-h-front-porch = <120>;
		qcom,mdss-dsi-h-back-porch = <250>;
		qcom,mdss-dsi-h-pulse-width = <20>;
		qcom,mdss-dsi-h-sync-skew = <0>;
		qcom,mdss-dsi-v-back-porch = <17>;
		qcom,mdss-dsi-v-front-porch = <21>;
		qcom,mdss-dsi-v-pulse-width = <4>;
		qcom,mdss-dsi-h-left-border = <0>;
		qcom,mdss-dsi-h-right-border = <0>;
		qcom,mdss-dsi-v-top-border = <0>;
		qcom,mdss-dsi-v-bottom-border = <0>;
		qcom,mdss-dsi-bpp = <24>;
		qcom,mdss-dsi-underflow-color = <0xff>;
		qcom,mdss-dsi-border-color = <0>;
        qcom,mdss-dsi-on-command = [
39 01 00 00 00 00 02 00 00 
39 01 00 00 00 00 04 ff 12 84 01 
39 01 00 00 00 00 02 00 80 
39 01 00 00 00 00 03 ff 12 84 
39 01 00 00 00 00 02 00 92 
39 01 00 00 00 00 03 ff 30 02 
39 01 00 00 00 00 02 00 80 
39 01 00 00 10 00 0A c0 00 64 00 10 10 00 64 10 10
39 01 00 00 00 00 02 00 90 
39 01 00 00 10 00 07 c0 00 5c 00 01 00 04 
39 01 00 00 00 00 02 00 b3  
39 01 00 00 00 00 03 c0 00 55 
39 01 00 00 00 00 02 00 81 
39 01 00 00 00 00 02 c1 55 
39 01 00 00 00 00 02 00 a0 
39 01 00 00 10 00 0F c4 05 10 06 02 05 15 10 05 10 07 02 05 15 10
39 01 00 00 00 00 02 00 b0
39 01 00 00 00 00 03 c4 00 00
39 01 00 00 00 00 02 00 91 
39 01 00 00 00 00 03 c5 46 42
39 01 00 00 00 00 02 00 00 
39 01 00 00 00 00 03 d8 bc bc
39 01 00 00 00 00 02 00 00
39 01 00 00 00 00 02 d9 62
39 01 00 00 00 00 02 00 b3 
39 01 00 00 00 00 02 c5 84 
39 01 00 00 00 00 02 00 bb
39 01 00 00 00 00 02 c5 8a 
39 01 00 00 00 00 02 00 82 
39 01 00 00 00 00 02 C4 0a
39 01 00 00 00 00 02 00 c6 
39 01 00 00 00 00 02 B0 03  
39 01 00 00 00 00 02 00 c2  
39 01 00 00 00 00 02 f5 40 
39 01 00 00 00 00 02 00 c3  
39 01 00 00 00 00 02 f5 85
39 01 00 00 00 00 02 00 87
39 01 00 00 00 00 02 c4 18
39 01 00 00 00 00 02 00 00
39 01 00 00 00 00 02 d0 40
39 01 00 00 00 00 02 00 00
39 01 00 00 00 00 03 d1 00 00
39 01 00 00 00 00 02 00 80
39 01 00 00 10 00 0C cb 00 00 00 00 00 00 00 00 00 00 00
39 01 00 00 00 00 02 00 90
39 01 00 00 10 00 10 cb 00 00 00 00 00 00 00 00 00 00 00 00 00 00 00
39 01 00 00 00 00 02 00 a0  
39 01 00 00 10 00 10 cb 00 00 00 00 00 00 00 00 00 00 00 00 00 00 00 
39 01 00 00 00 00 02 00 b0  
39 01 00 00 10 00 10 cb 00 00 00 00 00 00 00 00 00 00 00 00 00 00 00 
39 01 00 00 00 00 02 00 c0 
39 01 00 00 10 00 10 cb 05 05 05 05 05 00 00 00 00 00 00 00 00 00 00 
39 01 00 00 00 00 02 00 d0  
39 01 00 00 10 00 10 cb ff ff ff 00 05 05 05 05 05 05 05 05 00 00 00 
39 01 00 00 00 00 02 00 e0  
39 01 00 00 10 00 0F cb 00 00 00 00 00 00 00 ff ff ff 00 05 05 05 
39 01 00 00 00 00 02 00 f0 
39 01 00 00 10 00 0C cb ff ff ff ff ff ff ff ff ff ff ff 
39 01 00 00 00 00 02 00 80  
39 01 00 00 10 00 10 cc 02 0a 0c 0e 10 00 00 00 00 00 00 00 00 00 00 
39 01 00 00 00 00 02 00 90  
39 01 00 00 10 00 10 cc 00 00 00 00 2e 2d 06 01 09 0b 0d 0f 00 00 00 
39 01 00 00 00 00 02 00 a0  
39 01 00 00 10 00 0F cc 00 00 00 00 00 00 00 00 00 00 00 2e 2d 05 
39 01 00 00 00 00 02 00 b0 
39 01 00 00 10 00 10 cc 05 0f 0d 0b 09 00 00 00 00 00 00 00 00 00 00 
39 01 00 00 00 00 02 00 c0 
39 01 00 00 10 00 10 cc 00 00 00 00 2d 2e 01 06 10 0e 0c 0a 00 00 00 
39 01 00 00 00 00 02 00 d0  
39 01 00 00 10 00 0F cc 00 00 00 00 00 00 00 00 00 00 00 2d 2e 02 
39 01 00 00 00 00 02 00 80  
39 01 00 00 10 00 0D ce 87 03 10 86 03 10 00 00 00 00 00 00
39 01 00 00 00 00 02 00 90
39 01 00 00 10 00 0F ce 35 01 10 35 02 10 00 00 00 00 00 00 00 00
39 01 00 00 00 00 02 00 a0
39 01 00 00 10 00 0F ce 38 03 04 f8 00 10 00 38 02 04 f9 00 10 00
39 01 00 00 00 00 02 00 b0
39 01 00 00 10 00 0F ce 38 01 04 fa 00 10 00 38 00 04 fb 00 10 00
39 01 00 00 00 00 02 00 c0
39 01 00 00 10 00 0F ce 30 00 04 fc 00 10 00 30 01 04 fd 00 10 00
39 01 00 00 00 00 02 00 d0
39 01 00 00 10 00 0F ce 30 02 04 fe 00 10 00 30 03 04 ff 00 10 00
39 01 00 00 00 00 02 00 80
39 01 00 00 10 00 0F cf 00 00 00 00 00 00 00 00 00 00 00 00 00 00
39 01 00 00 00 00 02 00 90
39 01 00 00 10 00 0F cf 00 00 00 00 00 00 00 00 00 00 00 00 00 00
39 01 00 00 00 00 02 00 a0
39 01 00 00 10 00 0F cf 00 00 00 00 00 00 00 00 00 00 00 00 00 00
39 01 00 00 00 00 02 00 b0
39 01 00 00 10 00 0F cf 00 00 00 00 00 00 00 00 00 00 00 00 00 00
39 01 00 00 00 00 02 00 c0
39 01 00 00 10 00 0C cf 01 01 20 20 00 00 01 81 00 03 08
39 01 00 00 00 00 02 00 b5
39 01 00 00 00 00 07 c5 3f ff ff 3f ff ff
39 01 00 00 00 00 02 00 90
39 01 00 00 00 00 05  f5 02 11 02 15
39 01 00 00 00 00 02 00 90
39 01 00 00 00 00 02 c5 50
39 01 00 00 00 00 02 00 94
39 01 00 00 00 00 02 c5 66
39 01 00 00 00 00 02 00 b2
39 01 00 00 00 00 03 f5 00 00
39 01 00 00 00 00 02 00 b4
39 01 00 00 00 00 03 f5 00 00
39 01 00 00 00 00 02 00 b6
39 01 00 00 00 00 03 f5 00 00
39 01 00 00 00 00 02 00 b8
39 01 00 00 00 00 03 f5 00 00
39 01 00 00 00 00 02 00 94
39 01 00 00 00 00 03 f5 00 00
39 01 00 00 00 00 02 00 d2
39 01 00 00 00 00 03 f5 06 15
39 01 00 00 00 00 02 00 b4
39 01 00 00 00 00 02 c5 cc
39 01 00 00 00 00 02 00 00
39 01 00 00 10 00 15 E1 00 14 22 2E 40 4E 51 81 75 92 6F 58 6A 48 47 3C 2E 1F 0E 00
39 01 00 00 00 00 02 00 00
39 01 00 00 10 00 15 E2 00 14 22 2E 40 4E 51 81 75 92 70 59 6B 47 47 3C 2E 1F 0E 00
39 01 00 00 00 00 02 00 00
39 01 00 00 00 00 04 ff ff ff ff
39 01 00 00 96 00 02 11 00
39 01 00 00 32 00 02 29 00
];
qcom,mdss-dsi-off-command = [
05 01 00 00 0a 00 02 28 00
05 01 00 00 96 00 02 10 00
];
	qcom,mdss-dsi-on-command-state = "dsi_lp_mode";
	qcom,mdss-dsi-off-command-state = "dsi_hs_mode";
	qcom,mdss-dsi-h-sync-pulse = <1>;
	qcom,mdss-dsi-traffic-mode = <2>;
	qcom,mdss-dsi-lane-map = <0>;
	qcom,mdss-dsi-bllp-eof-power-mode;
	qcom,mdss-dsi-bllp-power-mode;
	qcom,mdss-dsi-lane-0-state;
	qcom,mdss-dsi-lane-1-state;
	qcom,mdss-dsi-lane-2-state;
	qcom,mdss-dsi-lane-3-state;
	qcom,mdss-dsi-panel-timings = [7D 24 19 00 34 2F 1E 26 2A 03 04 00];
	qcom,mdss-dsi-t-clk-post = <0x04>;
	qcom,mdss-dsi-t-clk-pre = <0x15>;
	qcom,mdss-dsi-bl-min-level = <0>;
	qcom,mdss-dsi-bl-max-level = <255>;
	qcom,mdss-dsi-dma-trigger = <4>;
	qcom,mdss-dsi-mdp-trigger = <0>;
	qcom,mdss-pan-bl-levels = <1 255>;
	qcom,mdss-dsi-bl-pmic-control-type = "bl_ctrl_pwm";
	qcom,mdss-dsi-bl-pmic-bank-select = <0>;
	qcom,mdss-dsi-bl-pmic-pwm-frequency = <270>; 
	qcom,mdss-dsi-pwm-gpio = <&pm8916_mpps 4 0>;
	qcom,mdss-dsi-reset-sequence = <1 50>, <0 50>, <1 120>;
	};
};
