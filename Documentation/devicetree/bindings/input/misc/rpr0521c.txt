## Documentation/devicetree/bindings/input/misc/rpr0521c.txt
```
ROHM rpr0521c ambient light + proximity combo driver

Required properties:

 - compatible					: Should be "rohm,rpr0521c".
 - reg							: i2c slave address of the device.
 - interrupt-parent				: Parent of interrupt.
 - interupts					: L/P sample interrupt to indicate new data ready.
 - vdd-supply					: Power supply needed to power up the device.
 - vio-supply					: IO power supply needed for IO and I2C.
 - rpr0521c,irq-gpio			: The gpio pin for the interrupt.
 - rpr0521c,prox_th_min			: The threshold adc value for proximity sensor to trigger away interrupt.
 - rpr0521c,prox_th_max			: The threshold adc value for proximity sensor to trigger  close interrupt.

 Example:

	rohm@38 { /* Ambient light and proximity sensor */
		compatible = "rohm,rpr0521c";
		reg = <0x38>;
		pinctrl-names = "default","sleep";
		pinctrl-0 = <&rpr0521c_default>;
		pinctrl-1 = <&rpr0521c_sleep>;
		interrupt-parent = <&msm_gpio>;
		interrupts = <113 0x2002>;
		vdd-supply = <&pm8916_l17>;
		vio-supply = <&pm8916_l6>;
		rpr0521c,irq-gpio = <&msm_gpio 113 0x2002>;
		rpr0521c,prox_th_min = <50>;
		rpr0521c,prox_th_max = <150>;
	};
```

## arch/arm/mach-msm/product_list/Kconfig
```kconfig
#Product config list

config PRODUCT_P1071
	depends on ARCH_MSM8916
	bool "PRODUCT_P1071 version"
	help
	  Fix version type as PRODUCT_P1071.		
config PRODUCT_A3002
	depends on ARCH_MSM8916
	bool "PRODUCT_A3002 version"
	help
	  Fix version type as PRODUCT_A3002.	
config PRODUCT_A3001
	depends on ARCH_MSM8916
	bool "PRODUCT_A3001 version"
	help
	  Fix version type as PRODUCT_A3001.	

	  
```

## arch/arm64/product_list/Kconfig
```kconfig
config PRODUCT_A2001
	depends on ARCH_MSM8916
	bool "PRODUCT_A2001 version"
	help
	  Fix version type as PRODUCT_A2001.

config PRODUCT_A3001
	depends on ARCH_MSM8916
	bool "PRODUCT_A3001 version"
	help
	  Fix version type as PRODUCT_A3001.
config PRODUCT_A3002
	depends on ARCH_MSM8916
	bool "PRODUCT_A3002 version"
	help
	  Fix version type as PRODUCT_A3002.
```

## drivers/micronet/accel/Kconfig
```kconfig
menuconfig MICRONET_OBC
	bool "Micronet OBC drivers"
	---help---
	  Say Y here to get Micronet OBC drivers.


if MICRONET_OBC

config MICRONET_VACCEL
	tristate "Micronet Virtual Accellerometer FIFO driver"
	help
	  Micronet OBC virtual accellerometer Driver.


endif
		
```

## drivers/micronet/one_wire/Kconfig
```kconfig
menuconfig MICRONET_OBC
	bool "Micronet OBC drivers"
	---help---
	  Say Y here to get Micronet OBC drivers.


if MICRONET_OBC

config MICRONET_ONE_WIRE
	tristate "One wire driver"
	help
	  Micronet OBC one wire Driver.


endif
		
```

## drivers/micronet/suspend_timeout/Kconfig
```kconfig
config MICRONET_SUSPEND
	tristate "Micronet suspend timeout"
	help
	  Micronet OBC suspend timeout Driver.

		
```
